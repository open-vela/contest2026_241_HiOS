## board/metalio-claw-4/Kconfig
```kconfig
#
# Metalio Claw4 board options
#

if ARCH_BOARD_METALIO_CLAW_4

config METALIO_DISPLAY_NV3051F
	bool "Use NV3051F MIPI-DSI panel (default production)"
	default y
	select ESPRESSIF_MIPI_DSI
	select VIDEO_FB
	select FB_UPDATE
	---help---
		Select NV3051F 720x720 panel. Disable to use FL7707N instead.

config METALIO_DISPLAY_FL7707N
	bool "Use FL7707N MIPI-DSI panel"
	default n
	depends on !METALIO_DISPLAY_NV3051F
	select ESPRESSIF_MIPI_DSI
	select VIDEO_FB
	select FB_UPDATE

config METALIO_CAMERA_OV2710
	bool "OV2710 MIPI-CSI camera (V4L2 /dev/video0)"
	default y
	select ESPRESSIF_MIPI_CSI
	---help---
		Enable the OV2710 RAW10 image sensor and register a V4L2 capture
		device at /dev/video0 backed by the ESP32-P4 MIPI-CSI host.  The
		sensor uses 1 CSI-2 data lane at 800 Mbps/lane (RAW10 1920x1080
		@ 25 fps) and is controlled over the shared I2C0 SCCB link.

config METALIO_TOUCH_GT911
	bool "GT911 capacitive touch"
	default y

config METALIO_ESP_HOSTED
	bool "ESP-Hosted Wi-Fi host (ESP32-C5 over SDIO)"
	default n
	---help---
		Enable P4 host-side ESP-Hosted netdev over SDIO Slot1.

config METALIO_NT26_4G
	bool "NT26 4G modem support"
	default n

config ESP32P4_SELECTS_REV_LESS_V3
	bool "Allow ESP32-P4 chip revision < v3.0"
	default y
	---help---
		Metalio units may ship with P4 rev < 3.0. Enable to bypass bootloader pin.

endif # ARCH_BOARD_METALIO_CLAW_4
```

## board/metalio-claw-4/configs/lvgl/defconfig
```kconfig
#
# Metalio Claw4 LVGL display/touch configuration
#
CONFIG_ARCH="risc-v"
CONFIG_ARCH_BOARD="metalio-claw-4"
CONFIG_ARCH_BOARD_COMMON=y
CONFIG_ARCH_BOARD_METALIO_CLAW_4=y
CONFIG_ARCH_CHIP="esp32p4"
CONFIG_ARCH_CHIP_ESP32P4=y
CONFIG_ESPRESSIF_CHIP_SERIES="esp32p4"
CONFIG_ESP32P4_SELECTS_REV_LESS_V3=y
CONFIG_ESPRESSIF_FLASH_32M=y
CONFIG_ARCH_INTERRUPTSTACK=2048
CONFIG_ARCH_IRQ_TO_NDX=y
CONFIG_ARCH_MINIMAL_VECTORTABLE_DYNAMIC=y
CONFIG_ARCH_NUSER_INTERRUPTS=17
CONFIG_ARCH_RISCV=y
CONFIG_BOARDCTL=y
CONFIG_BOARD_LATE_INITIALIZE=y
CONFIG_BOARD_LOOPSPERMSEC=15000
CONFIG_BUILTIN=y
CONFIG_ESPRESSIF_I2C0=y
CONFIG_EXPERIMENTAL=y
CONFIG_FS_PROCFS=y
CONFIG_GRAPHICS_LVGL=y
CONFIG_LV_THEME_DEFAULT_DARK=y
CONFIG_I2C=y
CONFIG_IDLETHREAD_STACKSIZE=4096
CONFIG_INIT_ENTRYPOINT="nsh_main"
CONFIG_LCD=y
CONFIG_LCD_FRAMEBUFFER=y
CONFIG_LV_USE_NUTTX=y
CONFIG_LV_USE_NUTTX_LCD=y
CONFIG_LV_USE_NUTTX_TOUCHSCREEN=y
CONFIG_METALIO_DISPLAY_NV3051F=y
CONFIG_METALIO_TOUCH_GT911=y
CONFIG_MM_REGIONS=2
CONFIG_NSH_ARCHINIT=y
CONFIG_NSH_BUILTIN_APPS=y
CONFIG_NSH_READLINE=y
CONFIG_ONESHOT=y
CONFIG_ONESHOT_COUNT=y
CONFIG_RR_INTERVAL=200
CONFIG_SCHED_LPWORK=y
CONFIG_SCHED_WAITPID=y
CONFIG_SYSTEM_NSH=y
CONFIG_UART0_SERIAL_CONSOLE=y
CONFIG_VIDEO_FB=y
```

## board/metalio-claw-4/configs/wifi/defconfig
```kconfig
#
# Metalio Claw4 Wi-Fi (ESP-Hosted over SDIO) configuration
#
CONFIG_ARCH="risc-v"
CONFIG_ARCH_BOARD="metalio-claw-4"
CONFIG_ARCH_BOARD_COMMON=y
CONFIG_ARCH_BOARD_METALIO_CLAW_4=y
CONFIG_ARCH_CHIP="esp32p4"
CONFIG_ARCH_CHIP_ESP32P4=y
CONFIG_ESPRESSIF_CHIP_SERIES="esp32p4"
CONFIG_ESP32P4_SELECTS_REV_LESS_V3=y
CONFIG_ESPRESSIF_FLASH_32M=y
CONFIG_ARCH_INTERRUPTSTACK=2048
CONFIG_ARCH_IRQ_TO_NDX=y
CONFIG_ARCH_MINIMAL_VECTORTABLE_DYNAMIC=y
CONFIG_ARCH_NUSER_INTERRUPTS=17
CONFIG_ARCH_RISCV=y
CONFIG_BOARDCTL=y
CONFIG_BOARD_LATE_INITIALIZE=y
CONFIG_BOARD_LOOPSPERMSEC=15000
CONFIG_BUILTIN=y
CONFIG_ESPRESSIF_I2C0=y
CONFIG_EXPERIMENTAL=y
CONFIG_FS_PROCFS=y
CONFIG_I2C=y
CONFIG_IDLETHREAD_STACKSIZE=3072
CONFIG_INIT_ENTRYPOINT="nsh_main"
CONFIG_INTELHEX_BINARY=y
CONFIG_IOB_NBUFFERS=64
CONFIG_METALIO_ESP_HOSTED=y
CONFIG_MM_REGIONS=2
CONFIG_NET=y
CONFIG_NETDB_DNSCLIENT=y
CONFIG_NETDEV_LATEINIT=y
CONFIG_NETUTILS_DHCPC=y
CONFIG_NET_ETH_PKTSIZE=1514
CONFIG_NET_ICMP=y
CONFIG_NET_IPv4=y
CONFIG_NET_TCP=y
CONFIG_NET_UDP=y
CONFIG_NSH_ARCHINIT=y
CONFIG_NSH_BUILTIN_APPS=y
CONFIG_NSH_READLINE=y
CONFIG_ONESHOT=y
CONFIG_ONESHOT_COUNT=y
CONFIG_RR_INTERVAL=200
CONFIG_SCHED_LPWORK=y
CONFIG_SCHED_WAITPID=y
CONFIG_SYSTEM_NSH=y
CONFIG_SYSTEM_PING=y
CONFIG_UART0_SERIAL_CONSOLE=y
CONFIG_WIRELESS=y
CONFIG_WIRELESS_WAPI=y
CONFIG_WIRELESS_WAPI_CMDTOOL=y
```

## vendor/metalio/drivers/esp_hosted/Kconfig
```kconfig
menuconfig METALIO_ESP_HOSTED_DRIVER
	bool "Metalio ESP-Hosted SDIO Wi-Fi host driver"
	default y if METALIO_ESP_HOSTED
	depends on NET
	---help---
		P4 host netdev talking to ESP32-C5 slave over SDIO Slot1.
```
